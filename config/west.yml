## config/west.yml
```yaml
manifest:
  remotes:
    - name: zmkfirmware
      url-base: https://github.com/zmkfirmware
  projects:
    - name: zmk
      remote: zmkfirmware
      revision: main
      import: app/west.yml
  self:
    path: config
build:
  - board: nice_nano_v2
    shield: lily58_nrf_split_left
  - board: nice_nano_v2
    shield: lily58_nrf_split_right
```
